## firmware/mqtt_heartbeat/components/platform_camera/Kconfig.projbuild
```kconfig
menu "Ego Link platform camera"

    config EGOLINK_PLATFORM_CAMERA_ENABLED
        bool "Enable bounded OV5640 single-frame camera seam"
        default n
        depends on IDF_TARGET_ESP32S3
        help
            Opt-in engineering seam for the camera connector on the existing
            Waveshare ESP32-S3-SIM7670G-4G board. One call performs at most one
            init and one QVGA JPEG frame acquisition using one internal-DRAM
            framebuffer, returns the framebuffer, and deinitializes the
            driver. This deliberately leaves PSRAM disabled so the existing
            always-lock-free atomic invariants remain valid. Runtime internal
            heap headroom remains an unverified hardware gate. This does not
            enable commands, periodic capture, upload, or physical camera
            power switching.

    choice EGOLINK_PLATFORM_CAMERA_SHARED_I2C_GATE
        prompt "Shared platform I2C0 camera authorization state"
        default EGOLINK_PLATFORM_CAMERA_SHARED_I2C_BLOCKED
        depends on EGOLINK_PLATFORM_CAMERA_ENABLED
        help
            BLOCKED is the normal fail-closed Camera profile. The two opt-in
            authorization states are deliberately mutually exclusive.

        config EGOLINK_PLATFORM_CAMERA_SHARED_I2C_BLOCKED
            bool "BLOCKED: no shared-I2C camera capture authorization"
            help
                Default state. The driver remains compiled for integration
                checks, but capture fails before touching camera hardware.

        config EGOLINK_PLATFORM_CAMERA_SHARED_I2C_VERIFIED
            bool "Operator verified camera coexistence on shared platform I2C0"
            help
                The camera profile forces esp32-camera to its legacy SCCB
                driver and existing-I2C0 mode. platform_i2c_bus remains the
                sole bus installer/owner on GPIO15/16; camera deinit must not
                delete it. Select this only after a named joint-image hardware
                result verifies capture plus QMI8658A/MAX17048 continuity on
                the actual wiring.

        config EGOLINK_PLATFORM_CAMERA_SHARED_I2C_UNVERIFIED_TRIAL
            bool "DANGER: authorize one unverified shared-I2C trial per boot"
            depends on EGOLINK_COLLECTION_CAMERA_PROFILE
            help
                Engineering evidence mode only. This permits at most one
                bounded hardware capture attempt per boot through the existing
                capture_photo_once command path. It rejects timer enable and
                never represents hardware verification. A separately reviewed
                image must select VERIFIED after accepting named live evidence.

    endchoice

endmenu
```

## firmware/mqtt_heartbeat/components/platform_imu/Kconfig.projbuild
```kconfig
menu "Ego Link platform IMU"

    choice EGOLINK_PLATFORM_IMU_BACKEND
        prompt "Platform IMU backend"
        default EGOLINK_PLATFORM_IMU_BACKEND_MOCK
        help
            Select the source used by platform_imu_sample(). Keep the mock
            backend for the P0 4G board until a real board IMU is explicitly
            wired, probed, and accepted.

        config EGOLINK_PLATFORM_IMU_BACKEND_MOCK
            bool "Mock stationary IMU"

        config EGOLINK_PLATFORM_IMU_BACKEND_QMI8658
            bool "QMI8658 I2C backend"
            help
                Experimental opt-in backend for QMI8658 accel/gyro samples.
                This does not by itself prove product mounting, FIFO/interrupt
                behavior, power, calibration, or formal IMU acceptance.
    endchoice

    config EGOLINK_PLATFORM_IMU_QMI8658_I2C_PORT
        int "QMI8658 I2C port"
        default 0
        range 0 1
        depends on EGOLINK_PLATFORM_IMU_BACKEND_QMI8658

    config EGOLINK_PLATFORM_IMU_QMI8658_SDA_GPIO
        int "QMI8658 I2C SDA GPIO"
        default 15
        range 0 48
        depends on EGOLINK_PLATFORM_IMU_BACKEND_QMI8658

    config EGOLINK_PLATFORM_IMU_QMI8658_SCL_GPIO
        int "QMI8658 I2C SCL GPIO"
        default 14
        range 0 48
        depends on EGOLINK_PLATFORM_IMU_BACKEND_QMI8658

    config EGOLINK_PLATFORM_IMU_QMI8658_I2C_FREQ_HZ
        int "QMI8658 I2C frequency"
        default 100000
        range 10000 400000
        depends on EGOLINK_PLATFORM_IMU_BACKEND_QMI8658

    config EGOLINK_PLATFORM_IMU_QMI8658_I2C_TIMEOUT_MS
        int "QMI8658 I2C timeout"
        default 1000
        range 10 5000
        depends on EGOLINK_PLATFORM_IMU_BACKEND_QMI8658

    config EGOLINK_PLATFORM_IMU_QMI8658_I2C_ADDR
        int "QMI8658 I2C address"
        default 107
        range 0 127
        depends on EGOLINK_PLATFORM_IMU_BACKEND_QMI8658
        help
            Decimal 107 is 0x6B, the address used by the AMOLED bridge board.

    config EGOLINK_PLATFORM_IMU_QMI8658_WHOAMI_EXPECTED
        int "QMI8658 expected WHOAMI"
        default 5
        range 0 255
        depends on EGOLINK_PLATFORM_IMU_BACKEND_QMI8658

    config EGOLINK_PLATFORM_IMU_QMI8658_SAMPLE_INTERVAL_MS
        int "QMI8658 nominal sample interval"
        default 50
        range 1 1000
        depends on EGOLINK_PLATFORM_IMU_BACKEND_QMI8658

    config EGOLINK_PLATFORM_IMU_QMI8658_AXP2101_RAILS
        bool "Enable AMOLED-board AXP2101 rails before QMI8658 probe"
        default y
        depends on EGOLINK_PLATFORM_IMU_BACKEND_QMI8658
        help
            Enable the minimal AXP2101 DC1/ALDO1 rails used by the
            ESP32-S3-Touch-AMOLED-2.06 QMI8658 bring-up path. Disable this for
            a board where QMI8658 is powered independently.

    config EGOLINK_PLATFORM_IMU_BOOT_SAMPLE_COUNT
        int "Boot-time IMU sample count"
        default 0
        range 0 1000
        help
            Emit a bounded IMU sampling window to the serial log during boot,
            before network attach. Keep this disabled in the default product
            path; enable it for hardware bring-up when MQTT is unavailable.

    config EGOLINK_PLATFORM_IMU_BOOT_SAMPLE_INTERVAL_MS
        int "Boot-time IMU sample interval"
        default 50
        range 1 1000
        depends on EGOLINK_PLATFORM_IMU_BOOT_SAMPLE_COUNT > 0

endmenu
```

## firmware/mqtt_heartbeat/components/platform_power/Kconfig.projbuild
```kconfig
menu "Ego Link platform power"

    choice EGOLINK_PLATFORM_POWER_BACKEND
        prompt "Platform power backend"
        default EGOLINK_PLATFORM_POWER_BACKEND_MOCK
        help
            Select the source used by platform_power_get_snapshot() battery
            fields. Keep the mock backend by default; the MAX17048 backend is
            an explicit opt-in for the PWR-001 battery baseline and does not
            by itself prove product battery life, charging detection, or
            power acceptance.

        config EGOLINK_PLATFORM_POWER_BACKEND_MOCK
            bool "Mock battery"

        config EGOLINK_PLATFORM_POWER_BACKEND_MAX17048
            bool "MAX17048 fuel gauge I2C backend"
            help
                Reads state-of-charge and cell voltage from the on-board
                MAX17048 fuel gauge. Charging state remains mock: MAX17048
                does not report charger state. Waveshare documents V2 battery
                I2C as SDA GPIO15 / SCL GPIO16 and V1 as SDA GPIO3 / SCL GPIO2;
                confirm the active board revision before trusting readings.
    endchoice

    config EGOLINK_PLATFORM_POWER_MAX17048_I2C_PORT
        int "MAX17048 I2C port"
        default 0
        range 0 1
        depends on EGOLINK_PLATFORM_POWER_BACKEND_MAX17048

    config EGOLINK_PLATFORM_POWER_MAX17048_SDA_GPIO
        int "MAX17048 I2C SDA GPIO"
        default 15
        range 0 48
        depends on EGOLINK_PLATFORM_POWER_BACKEND_MAX17048
        help
            Default follows Waveshare V2 battery I2C documentation. Override
            to GPIO3 for V1 boards after board-revision confirmation.

    config EGOLINK_PLATFORM_POWER_MAX17048_SCL_GPIO
        int "MAX17048 I2C SCL GPIO"
        default 16
        range 0 48
        depends on EGOLINK_PLATFORM_POWER_BACKEND_MAX17048
        help
            Default follows Waveshare V2 battery I2C documentation. Override
            to GPIO2 for V1 boards after board-revision confirmation.

    config EGOLINK_PLATFORM_POWER_MAX17048_I2C_FREQ_HZ
        int "MAX17048 I2C frequency"
        default 100000
        range 10000 400000
        depends on EGOLINK_PLATFORM_POWER_BACKEND_MAX17048

    config EGOLINK_PLATFORM_POWER_MAX17048_I2C_TIMEOUT_MS
        int "MAX17048 I2C timeout"
        default 1000
        range 10 5000
        depends on EGOLINK_PLATFORM_POWER_BACKEND_MAX17048

endmenu
```

## firmware/mqtt_heartbeat/components/sim7670_gnss/Kconfig.projbuild
```kconfig
menu "Ego Link SIM7670G GNSS"

config EGOLINK_SIM7670_GNSS_ENABLED
    bool "Enable SIM7670G firmware GNSS AT query"
    default n
    depends on EGOLINK_MESSAGE_HUB_HTTP_ENABLED
    help
        Opt-in FW-002B path. When enabled, request_location queries the
        SIM7670G module through UART AT commands and reports a real module
        no-fix/fix state. It does not prove outdoor fix or LTE data transport.

config EGOLINK_SIM7670_LTE_STATUS_ENABLED
    bool "Enable SIM7670G LTE registration and cell state query"
    default n
    depends on EGOLINK_MESSAGE_HUB_HTTP_ENABLED
    help
        Opt-in LTE-001A observability path. When enabled, status and telemetry
        uploads include SIM, registration, PDP, APN, cell fingerprint, and
        signal state queried through SIM7670G UART AT commands. It does not
        route Message Hub HTTP traffic through LTE or prove LTE data transport.

config EGOLINK_SIM7670_LTE_HTTP_PROBE_ENABLED
    bool "Enable SIM7670G LTE HTTP uplink probe"
    default n
    depends on EGOLINK_MESSAGE_HUB_HTTP_ENABLED && EGOLINK_SIM7670_LTE_STATUS_ENABLED
    help
        Opt-in LTE-002 path. When enabled, firmware skips Wi-Fi as the runtime
        data path and uses SIM7670G AT HTTP commands to POST a bounded
        lte_http_probe event to the Message Hub telemetry endpoint. This is a
        bounded LTE HTTP uplink slice only; command polling, ACK, reconnect,
        and long-run stability remain separate tasks.

config EGOLINK_SIM7670_UART_NUM
    int "SIM7670G UART number"
    default 1
    range 1 2
    depends on EGOLINK_SIM7670_GNSS_ENABLED || EGOLINK_SIM7670_LTE_STATUS_ENABLED || EGOLINK_SIM7670_LTE_HTTP_PROBE_ENABLED

config EGOLINK_SIM7670_UART_RX_GPIO
    int "SIM7670G UART RX GPIO"
    default 17
    range 0 48
    depends on EGOLINK_SIM7670_GNSS_ENABLED || EGOLINK_SIM7670_LTE_STATUS_ENABLED || EGOLINK_SIM7670_LTE_HTTP_PROBE_ENABLED
    help
        Official Waveshare ESP-IDF examples for ESP32-S3 + SIM7670X use
        ESP32-S3 RX GPIO17 connected to module TX.

config EGOLINK_SIM7670_UART_TX_GPIO
    int "SIM7670G UART TX GPIO"
    default 18
    range 0 48
    depends on EGOLINK_SIM7670_GNSS_ENABLED || EGOLINK_SIM7670_LTE_STATUS_ENABLED || EGOLINK_SIM7670_LTE_HTTP_PROBE_ENABLED
    help
        Official Waveshare ESP-IDF examples for ESP32-S3 + SIM7670X use
        ESP32-S3 TX GPIO18 connected to module RX.

config EGOLINK_SIM7670_UART_BAUD
    int "SIM7670G UART baud"
    default 115200
    depends on EGOLINK_SIM7670_GNSS_ENABLED || EGOLINK_SIM7670_LTE_STATUS_ENABLED || EGOLINK_SIM7670_LTE_HTTP_PROBE_ENABLED

config EGOLINK_SIM7670_AT_TIMEOUT_MS
    int "SIM7670G AT command timeout milliseconds"
    default 3000
    range 500 30000
    depends on EGOLINK_SIM7670_GNSS_ENABLED || EGOLINK_SIM7670_LTE_STATUS_ENABLED || EGOLINK_SIM7670_LTE_HTTP_PROBE_ENABLED

config EGOLINK_SIM7670_LTE_HTTP_ACTION_TIMEOUT_MS
    int "SIM7670G HTTPACTION timeout milliseconds"
    default 30000
    range 5000 120000
    depends on EGOLINK_SIM7670_LTE_HTTP_PROBE_ENABLED

config EGOLINK_SIM7670_LTE_HTTP_SET_CID_PARAM
    bool "Send AT+HTTPPARA CID before SIM7670G HTTP action"
    default n
    depends on EGOLINK_SIM7670_LTE_HTTP_PROBE_ENABLED
    help
        Some SIMCom HTTP examples for older modules set HTTPPARA CID manually,
        while the A7600/A7670-style HTTP flow activates PDP during HTTPINIT and
        does not require it. Keep this disabled for the SIM7670G thin slice
        unless hardware evidence shows this module accepts and needs it.

config EGOLINK_SIM7670_LTE_HTTP_READY_WAIT_SEC
    int "SIM7670G LTE HTTP probe readiness wait seconds"
    default 120
    range 0 600
    depends on EGOLINK_SIM7670_LTE_HTTP_PROBE_ENABLED
    help
        Maximum time LTE-002 waits for the SIM7670G status query to report
        LTE_READY before attempting HTTP. A value of 0 attempts immediately.

config EGOLINK_SIM7670_LTE_HTTP_READY_POLL_SEC
    int "SIM7670G LTE HTTP probe readiness poll seconds"
    default 5
    range 1 60
    depends on EGOLINK_SIM7670_LTE_HTTP_PROBE_ENABLED

config EGOLINK_SIM7670_LTE_HTTP_PROBE_MAX_ATTEMPTS
    int "SIM7670G LTE HTTP probe max attempts"
    default 6
    range 1 60
    depends on EGOLINK_SIM7670_LTE_HTTP_PROBE_ENABLED
    help
        Maximum number of LTE HTTP probe rounds to attempt before the LTE-002
        slice gives up. Each round refreshes LTE readiness and then posts the
        attempt/result telemetry pair.

config EGOLINK_SIM7670_LTE_HTTP_PROBE_RETRY_INTERVAL_SEC
    int "SIM7670G LTE HTTP probe retry interval seconds"
    default 20
    range 0 600
    depends on EGOLINK_SIM7670_LTE_HTTP_PROBE_ENABLED
    help
        Delay between failed LTE HTTP probe rounds. Keeping this bounded lets
        USB-Free validation observe retries without turning LTE-002 into a
        long-run reconnect supervisor.

config EGOLINK_SIM7670_GNSS_POWER_ON_BEFORE_QUERY
    bool "Send AT+CGNSSPWR=1 before GNSS query"
    default y
    depends on EGOLINK_SIM7670_GNSS_ENABLED

endmenu
```

## firmware/mqtt_heartbeat/components/sim7670_location_modem_owner/Kconfig.projbuild
```kconfig
menu "Ego Link LOC-021Q SIM7670 location modem owner"

config EGOLINK_SIM7670_LOCATION_MODEM_OWNER_ENABLED
    bool "Enable the LOC-021Q exclusive SIM7670 location modem owner"
    default n
    depends on EGOLINK_SIM7670_GNSS_ENABLED && EGOLINK_SIM7670_LTE_STATUS_ENABLED
    depends on !EGOLINK_SIM7670_LTE_HTTP_PROBE_ENABLED
    depends on !EGOLINK_SIM7670_LTE_HTTP_COMMAND_LOOP_ENABLED
    depends on !EGOLINK_SIM7670_LOCATION_OBSERVATION_ENABLED
    depends on !EGOLINK_SIM7670_D1_PERIODIC_LOCATION_ENABLED
    help
        Compile-only boundary for the dormant LOC-021Q owner component.
        Runtime start is still explicit and the component is not wired into
        app_main. These exclusions remove several known legacy modem modes,
        but LTE status itself still has direct callers in the current app.
        A later live profile must prove that every such caller is unreachable
        before it may start this exclusive owner.

endmenu
```

## firmware/mqtt_heartbeat/components/sim7670_p0_delivery_adapter/Kconfig.projbuild
```kconfig
menu "EgoLink SIM7670 P0 delivery adapter"

config EGOLINK_SIM7670_P0_DELIVERY_TEST_DRIVER_ENABLED
    bool "Allow injected P0 delivery driver in offline test builds"
    default n
    help
        Unit-test-only seam for deterministic fake-driver contract checks.
        Ordinary firmware must keep this disabled and use the built-in exact
        driver, which remains fail-closed until OPS-004 integrates reviewed
        modem CA, hostname/SNI and clock verification. This option must not be
        enabled in a flashed or field image.

endmenu
```
