## firmware/mqtt_heartbeat/components/sos_delivery_sender_task/Kconfig
```kconfig
menu "SOS delivery sender task"

config EGOLINK_SOS_DELIVERY_SENDER_TASK_ENABLED
    bool "Enable the independent SOS delivery sender owner"
    default n
    help
        Default-off Productization Sprint 1 integration seam. When an
        explicitly selected composition root enables it, one statically
        allocated task runs only the split-phase sender path. It neither owns
        GPIO nor creates credentials, a network bearer, a Call session, or a
        second SOS/outbox contract.

endmenu
```

## firmware/mqtt_heartbeat/main/Kconfig.projbuild
```kconfig
menu "Ego Link MQTT Heartbeat"

config EGOLINK_COLLECTION_PROFILE
    bool "Asynchronous raw collection engineering entry"
    default n

config EGOLINK_COLLECTION_CAMERA_PROFILE
    bool "16 MiB single-board camera collection runtime"
    default n
    depends on EGOLINK_COLLECTION_PROFILE && EGOLINK_PLATFORM_CAMERA_ENABLED
    help
        Selects the dedicated 16 MiB partition guards, media store and the
        existing Message Hub command/ACK route for the current single-board
        collector. Camera capture remains fail-closed until shared I2C
        ownership is explicitly verified. Source/build success is not
        hardware evidence.

config EGOLINK_PHOTO_COMMAND_POLL_INTERVAL_MS
    int "Photo command poll interval"
    default 2000
    range 500 60000
    depends on EGOLINK_COLLECTION_CAMERA_PROFILE

config EGOLINK_PHOTO_UPLOAD_RETRY_INITIAL_MS
    int "Photo upload initial retry backoff"
    default 2000
    range 500 60000
    depends on EGOLINK_COLLECTION_CAMERA_PROFILE

config EGOLINK_PHOTO_UPLOAD_RETRY_MAX_MS
    int "Photo upload maximum retry backoff"
    default 60000
    range 1000 300000
    depends on EGOLINK_COLLECTION_CAMERA_PROFILE

config EGOLINK_PHOTO_MEDIA_SLOT_BYTES
    int "Dedicated photo slot bytes"
    default 32768
    range 8192 131072
    depends on EGOLINK_COLLECTION_CAMERA_PROFILE

config EGOLINK_PHOTO_MEDIA_MAX_PAYLOAD_BYTES
    int "Maximum JPEG payload bytes"
    default 28672
    range 1024 126976
    depends on EGOLINK_COLLECTION_CAMERA_PROFILE

config EGOLINK_PHOTO_MEDIA_MAX_COMMITTED_PHOTOS
    int "Maximum retained committed photos"
    default 288
    range 1 512
    depends on EGOLINK_COLLECTION_CAMERA_PROFILE

config EGOLINK_PHOTO_MEDIA_MAX_TOTAL_PAYLOAD_BYTES
    int "Maximum retained JPEG payload bytes"
    default 8257536
    range 1048576 10485760
    depends on EGOLINK_COLLECTION_CAMERA_PROFILE

config EGOLINK_COLLECTION_RUN_SECONDS
    int "Collection session seconds (0: local continuous session)"
    range 0 86400
    default 300
    depends on EGOLINK_COLLECTION_PROFILE

config EGOLINK_COLLECTION_GNSS_INTERVAL_MS
    int "Independent GNSS query interval ms"
    range 1000 60000
    default 5000
    depends on EGOLINK_COLLECTION_PROFILE

config EGOLINK_COLLECTION_NO_SIM
    bool "No-SIM bench configuration (distinct from field SIM configuration)"
    default y
    depends on EGOLINK_COLLECTION_PROFILE

config EGOLINK_COLLECTION_LTE_PPP_ENABLED
    bool "Enable collector Wi-Fi-priority USB LTE/PPP fallback"
    default n
    depends on EGOLINK_COLLECTION_PROFILE && !EGOLINK_COLLECTION_NO_SIM
    depends on EGOLINK_COLLECTION_USB_LTE
    help
        Explicit engineering opt-in. The existing collection modem task remains
        the only AT/PPP control owner; the uploader consumes only the selected
        netif and route generation. This option requires an operator-verified
        USB descriptor and a preconfigured, observed PDP CID 1/APN. Firmware
        never guesses or writes an APN. It does not authorize SIM traffic.

config EGOLINK_COLLECTION_LTE_USB_DESCRIPTOR_VERIFIED
    bool "Operator verified exact USB LTE descriptor and modem interface"
    default n
    depends on EGOLINK_COLLECTION_LTE_PPP_ENABLED
    help
        Set only in ignored local configuration after recording the actual USB
        VID, PID, and CDC modem interface. A board or modem model name is not
        descriptor evidence. Enabled builds fail closed while this is false.

config EGOLINK_COLLECTION_LTE_USB_VENDOR_ID
    hex "USB LTE vendor ID"
    range 0x0000 0xffff
    default 0x0000
    depends on EGOLINK_COLLECTION_LTE_PPP_ENABLED

config EGOLINK_COLLECTION_LTE_USB_PRODUCT_ID
    hex "USB LTE product ID"
    range 0x0000 0xffff
    default 0x0000
    depends on EGOLINK_COLLECTION_LTE_PPP_ENABLED

config EGOLINK_COLLECTION_LTE_USB_MODEM_INTERFACE
    int "USB CDC modem interface number"
    range -1 255
    default -1
    depends on EGOLINK_COLLECTION_LTE_PPP_ENABLED

config EGOLINK_COLLECTION_LTE_USB_HOST_ALREADY_INSTALLED
    bool "USB host driver is already installed by the selected image"
    default n
    depends on EGOLINK_COLLECTION_LTE_PPP_ENABLED

config EGOLINK_COLLECTION_LTE_COMMAND_TIMEOUT_MS
    int "USB LTE command response timeout ms"
    range 100 10000
    default 5000
    depends on EGOLINK_COLLECTION_LTE_PPP_ENABLED

config EGOLINK_COLLECTION_LTE_ATTEMPT_TIMEOUT_MS
    int "Complete LTE attempt timeout ms"
    range 5000 120000
    default 45000
    depends on EGOLINK_COLLECTION_LTE_PPP_ENABLED

config EGOLINK_COLLECTION_LTE_RETRY_INITIAL_MS
    int "Initial LTE retry backoff ms"
    range 1000 300000
    default 5000
    depends on EGOLINK_COLLECTION_LTE_PPP_ENABLED

config EGOLINK_COLLECTION_LTE_RETRY_MAX_MS
    int "Maximum LTE retry backoff ms"
    range 1000 300000
    default 60000
    depends on EGOLINK_COLLECTION_LTE_PPP_ENABLED

config EGOLINK_COLLECTION_LTE_CLEANUP_TIMEOUT_MS
    int "LTE quiesce, escape, hangup, and PPP-dead timeout ms"
    range 3000 30000
    default 15000
    depends on EGOLINK_COLLECTION_LTE_PPP_ENABLED

config EGOLINK_WIFI_SSID
    string "Wi-Fi SSID"
    default ""
    help
        Runtime-only Wi-Fi configuration. Keep the tracked default empty and
        provide the real value through an ignored local sdkconfig.

config EGOLINK_WIFI_PASSWORD
    string "Wi-Fi password"
    default ""
    help
        Runtime-only Wi-Fi configuration. Keep the tracked default empty and
        provide the real value through an ignored local sdkconfig.

config EGOLINK_MQTT_BROKER_URI
    string "MQTT broker URI"
    default "mqtt://192.168.31.250:1883"

config EGOLINK_DEVICE_ID
    string "Device ID"
    default "ego-link-001"

config EGOLINK_FW_VERSION
    string "Firmware version label"
    default "0.1.0-mqtt-smoke"

config EGOLINK_TEST_RUN_ID
    string "Optional field-test run ID"
    default ""
    help
        Optional evidence binding for USB-Free field tests. Leave empty for
        normal local smoke builds. Real field-run IDs belong in ignored local
        sdkconfig files and must not contain secrets.

config EGOLINK_STATUS_TOPIC
    string "Status topic"
    default "ego/link/ego-link-001/status"

config EGOLINK_EVENT_TOPIC
    string "Event topic"
    default "ego/link/ego-link-001/event"

config EGOLINK_HEARTBEAT_INTERVAL_SEC
    int "Heartbeat interval seconds"
    default 10
    range 1 3600

config EGOLINK_SENSOR_EVENT_INTERVAL_SEC
    int "Sensor event interval seconds"
    default 30
    range 5 3600

config EGOLINK_MESSAGE_HUB_HTTP_ENABLED
    bool "Enable HTTPS VPS Message Hub transport"
    default n
    select MBEDTLS_CERTIFICATE_BUNDLE
    help
        Keep this disabled for the existing local MQTT smoke path. Enable it
        only for a TLS-authenticated VPS Message Hub path. The legacy symbol
        name is retained for build compatibility; plaintext base URLs fail
        closed before network or sensor initialization.

config EGOLINK_MESSAGE_HUB_BASE_URL
    string "HTTPS Message Hub base URL"
    default "https://ego.example.invalid"
    depends on EGOLINK_MESSAGE_HUB_HTTP_ENABLED
    help
        Production-style device ingress. It must be an https URL whose
        authority exactly matches EGOLINK_MESSAGE_HUB_EXPECTED_TLS_HOST. An
        optional trailing slash is accepted; userinfo, explicit ports,
        queries, fragments, and other paths are rejected.

config EGOLINK_MESSAGE_HUB_EXPECTED_TLS_HOST
    string "Expected Message Hub TLS host"
    default "ego.example.invalid"
    depends on EGOLINK_MESSAGE_HUB_HTTP_ENABLED
    help
        Exact DNS host expected in the HTTPS base URL. ESP-TLS verifies the
        server certificate chain against the ESP-IDF certificate bundle and
        verifies this URL host. Keep this value free of a scheme, port, path,
        wildcard, or credentials.

config EGOLINK_MESSAGE_HUB_BEARER_TOKEN
    string "HTTPS Message Hub bearer token"
    default ""
    depends on EGOLINK_MESSAGE_HUB_HTTP_ENABLED
    help
        Runtime field-test secret. Do not commit a real token in sdkconfig,
        defaults, docs, or task packets.

config EGOLINK_MESSAGE_HUB_COMMAND_POLL_INTERVAL_SEC
    int "HTTPS Message Hub command poll interval seconds"
    default 10
    range 2 3600
    depends on EGOLINK_MESSAGE_HUB_HTTP_ENABLED

config EGOLINK_LTE_WIFI_FAILOVER_ENABLED
    bool "Enable bounded one-way LTE to Wi-Fi failover"
    default n
    depends on EGOLINK_MESSAGE_HUB_HTTP_ENABLED && EGOLINK_SIM7670_LTE_HTTP_COMMAND_LOOP_ENABLED
    help
        Engineering-only FW-007 path. LTE remains the initial and only owner.
        A bounded LTE attach failure or consecutive LTE HTTP poll failures can
        transfer ownership to the existing Wi-Fi Message Hub raw command,
        heartbeat, sensor, and location operations once per boot. The raw Wi-Fi
        command path reuses the LTE parser and executed-command cache. There is
        no automatic LTE failback, modem recovery, durable queue, or production
        Wi-Fi safety-link claim. Non-empty Wi-Fi SSID and password values must
        come from an ignored local sdkconfig.

config EGOLINK_LTE_WIFI_FAILOVER_FAILURE_THRESHOLD
    int "Consecutive LTE HTTP poll failures before Wi-Fi takeover"
    default 3
    range 1 20
    depends on EGOLINK_LTE_WIFI_FAILOVER_ENABLED
    help
        Counts consecutive failed LTE HTTP command polls. Any successful HTTP
        poll, including a valid empty-command response, resets the count. ACK
        outcome and command presence do not determine transport health.

config EGOLINK_WIFI_IMU_WINDOW_COMMAND_ENABLED
    bool "Enable bounded QMI8658 window command over Wi-Fi"
    default n
    depends on EGOLINK_MESSAGE_HUB_HTTP_ENABLED && EGOLINK_PLATFORM_IMU_BACKEND_QMI8658
    help
        Dedicated engineering profile for polling the existing EGLK/1 raw
        capture_imu_window command over Wi-Fi. It captures exactly 100 real
        QMI8658 samples at 50 ms, stops measurement before upload, and does
        not start periodic heartbeat or sensor telemetry tasks.

config EGOLINK_WIFI_IMU_WINDOW_POLL_MAX_ATTEMPTS
    int "Bounded Wi-Fi IMU command poll attempts"
    default 120
    range 1 360
    depends on EGOLINK_WIFI_IMU_WINDOW_COMMAND_ENABLED
    help
        Maximum raw command polls for the dedicated profile. This remains
        independent of the successful-command limit. A no-command response
        may continue within this bound; the first poll, command, upload, stop,
        or ACK error ends the task.

config EGOLINK_WIFI_IMU_WINDOW_MAX_SUCCESSFUL_COMMANDS
    int "Successful Wi-Fi IMU commands per boot"
    default 1
    range 1 4
    depends on EGOLINK_WIFI_IMU_WINDOW_COMMAND_ENABLED
    help
        Maximum independent capture_imu_window commands completed in one
        boot. A command counts only after capture, confirmed IMU stop, all
        chunks, manifest, and an ok ACK succeed. The first rejected, failed,
        duplicate, or unacknowledged command ends the task.

config EGOLINK_GNSS_LOCATION_SCAFFOLD_ENABLED
    bool "Enable request_location GNSS telemetry scaffold"
    default y
    depends on EGOLINK_MESSAGE_HUB_HTTP_ENABLED
    help
        When enabled, the HTTP Message Hub path responds to request_location
        by uploading an explicit location_report event with fix=false and
        source_status=unverified. This is a command/telemetry scaffold only;
        it does not control SIM7670G GNSS or claim a real fix.

config EGOLINK_LOC021_LIVE_PROFILE
    bool "Bounded single-source GNSS to Guardian via verified Wi-Fi HTTPS"
    default n
    depends on EGOLINK_SIM7670_LOCATION_MODEM_OWNER_ENABLED
    depends on !EGOLINK_LOC021S_MODEM_OWNER_SMOKE_PROFILE
    help
        Explicit engineering entry, 180 seconds, at most four GNSS commands,
        six HTTPS attempts and 32 outbox slot writes. Requires ignored Wi-Fi
        and bearer configuration. No physical SOS/IMU ingress or SIM traffic.

config EGOLINK_LOC021S_MODEM_OWNER_SMOKE_PROFILE
    bool "Build the isolated LOC-021S modem-owner smoke application"
    default n
    depends on EGOLINK_MESSAGE_HUB_HTTP_ENABLED
    depends on EGOLINK_SIM7670_GNSS_ENABLED && EGOLINK_SIM7670_LTE_STATUS_ENABLED
    depends on EGOLINK_SIM7670_LOCATION_MODEM_OWNER_ENABLED
    depends on !EGOLINK_SIM7670_LTE_HTTP_PROBE_ENABLED
    depends on !EGOLINK_SIM7670_LTE_HTTP_COMMAND_LOOP_ENABLED
    depends on !EGOLINK_SIM7670_LOCATION_OBSERVATION_ENABLED
    depends on !EGOLINK_SIM7670_D1_PERIODIC_LOCATION_ENABLED
    depends on !EGOLINK_LTE_WIFI_FAILOVER_ENABLED
    depends on !EGOLINK_WIFI_IMU_WINDOW_COMMAND_ENABLED
    help
        Selects a dedicated app_main translation unit instead of the legacy
        heartbeat application. The profile initializes the persistent outbox
        composition and starts exactly one boot-long LOC-021Q owner, then
        queues at most one bounded GNSS-status request. It contains no Wi-Fi,
        HTTP, external SOS, IMU, direct SIM7670 or UART call. The Message Hub
        symbol is currently only a build dependency of the existing GNSS/LTE
        driver Kconfig; this profile performs no network operation.

config EGOLINK_LOC021S_GNSS_STATUS_TIMEOUT_MS
    int "LOC-021S one-shot GNSS status timeout milliseconds"
    default 15000
    range 4000 120000
    depends on EGOLINK_LOC021S_MODEM_OWNER_SMOKE_PROFILE
    help
        Total bounded request budget. LOC-021Q reserves its configured tail
        for a never-cancelled GNSS power-off compensation before admitting a
        report. This is an engineering smoke value, not a product cadence.

config EGOLINK_LOC021S_OBSERVE_TIMEOUT_MS
    int "LOC-021S bounded metadata observation window milliseconds"
    default 30000
    range 1000 180000
    depends on EGOLINK_LOC021S_MODEM_OWNER_SMOKE_PROFILE
    help
        Maximum time app_main polls only Q's coordinate-free snapshot after
        queuing the one request. Expiry does not stop or delete the boot-long
        owner task and does not claim that an in-flight AT command ended.

endmenu
```
